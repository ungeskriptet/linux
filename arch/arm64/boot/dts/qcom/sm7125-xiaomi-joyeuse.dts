// SPDX-License-Identifier: GPL-2.0
/*
 * Copyright (c) 2023, David Wronek <davidwronek@gmail.com>
 */

/dts-v1/;

#include "sm7125-xiaomi-miatoll.dtsi"

/ {
	model = "Xiaomi Redmi Note 9 Pro (Global)";
	compatible = "xiaomi,joyeuse", "qcom,sm7125";

	/* required for bootloader to select correct board */
	qcom,board-id = <0x50022 1>;
};
