// SPDX-License-Identifier: GPL-2.0-only

/dts-v1/;

#include "msm8996-oneplus3.dtsi"

/ {
	model = "OnePlus 3T";
	compatible = "oneplus,oneplus3t", "qcom,msm8996";
	qcom,board-id = <8 0 15811 26>,
			<8 0 15811 27>,
			<8 0 15811 28>;
	qcom,msm-id = <305 0x10000>;
	qcom,pmic-id = <0x20009 0x10013 0x0 0x0>;
};

&gpu_opp_table {
	opp-652800000 {
		opp-hz = /bits/ 64 <652800000>;
		opp-supported-hw = <0x01>;
	};
};
