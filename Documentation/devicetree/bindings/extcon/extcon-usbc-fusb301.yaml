## Documentation/devicetree/bindings/extcon/extcon-usbc-fusb301.yaml
```yaml
# SPDX-License-Identifier: (GPL-2.0-only OR BSD-2-Clause)
%YAML 1.2
---
$id: http://devicetree.org/schemas/extcon/extcon-usbc-fusb301.yaml#
$schema: http://devicetree.org/meta-schemas/core.yaml#

title: onsemi FUSB301 USB Type-C Controller

maintainers:
  - Xhivat Hoxhiq <xhivo97@gmail.com>

properties:
  compatible:
    enum:
      - onnn,fusb301

  reg:
    maxItems: 1

  interrupts:
    maxItems: 1

required:
  - compatible
  - reg
  - interrupts

additionalProperties: false

examples:
  - |
    i2c0 {
        #address-cells = <1>;
        #size-cells = <0>;
        fusb301@21 {
            compatible = "onnn,fusb301";
            reg = <0x21>;
            interrupt-parent = <&gpio>;
            interrupts = <27 1>;
        };
    };
...
```

## Documentation/devicetree/bindings/input/twl-pwrbutton.txt
```
Texas Instruments TWL family pwrbutton module

This module is part of a TWL chip. For more details about the whole
chip see Documentation/devicetree/bindings/mfd/twl-family.txt.

This module provides a simple power button event via an Interrupt.

Required properties:
- compatible: should be one of the following
   - "ti,twl4030-pwrbutton": For controllers compatible with twl4030
   - "ti,twl6030-pwrbutton": For controllers compatible with twl6030
- interrupts: should be one of the following
   - <8>: For controllers compatible with the twl

Example:

&twl {
	twl_pwrbutton: pwrbutton {
		compatible = "ti,twl4030-pwrbutton";
		interrupts = <8>;
	};
};
```

## Documentation/devicetree/bindings/interconnect/qcom,msm8953.yaml
```yaml
# SPDX-License-Identifier: (GPL-2.0 OR BSD-2-Clause)
%YAML 1.2
---
$id: http://devicetree.org/schemas/interconnect/qcom,msm8953.yaml#
$schema: http://devicetree.org/meta-schemas/core.yaml#

title: Qualcomm MSM8953 Network-On-Chip interconnect

maintainers:
  - Vladimir Lypak <vladimir.lypak@gmail.com>

description: |
  The Qualcomm MSM8953 interconnect providers support adjusting the
  bandwidth requirements between the various NoC fabrics.

  See also:
  - dt-bindings/interconnect/qcom,msm8953.h

properties:
  reg:
    maxItems: 1

  compatible:
    enum:
      - qcom,msm8953-bimc
      - qcom,msm8953-pcnoc
      - qcom,msm8953-snoc
      - qcom,msm8953-snoc-mm

  '#interconnect-cells':
    const: 1

  clocks:
    minItems: 2
    maxItems: 3

  clock-names:
    minItems: 2
    maxItems: 3

  interconnect:
    type: object

required:
  - compatible
  - '#interconnect-cells'
  - clock-names
  - clocks

additionalProperties: false

allOf:
  - if:
      properties:
        compatible:
          contains:
            enum:
              - qcom,msm8953-pcnoc
    then:
      properties:
        clocks:
          items:
            - description: Bus Clock.
            - description: Bus A Clock.
            - description: PCNOC USB3 AXI Clock.
        clock-names:
          items:
            - const: bus
            - const: bus_a
            - const: pcnoc_usb3_axi

  - if:
      properties:
        compatible:
          contains:
            enum:
              - qcom,msm8953-bimc
              - qcom,msm8953-snoc
              - qcom,msm8953-snoc-mm
    then:
      properties:
        clocks:
          items:
            - description: Bus Clock.
            - description: Bus A Clock.
        clock-names:
          items:
            - const: bus
            - const: bus_a

  - if:
      properties:
        compatible:
          const: qcom,msm8953-snoc
    then:
      properties:
        interconnect:
          $ref: "#/"
          properties:
            compatible:
              const: qcom,msm8953-snoc-mm
      required:
        - interconnect
    else:
      properties:
        interconnect: false

  - if:
      properties:
        compatible:
          contains:
            enum:
              - qcom,msm8953-bimc
              - qcom,msm8953-snoc
              - qcom,msm8953-pcnoc
    then:
      required:
        - reg

examples:
  - |
      #include <dt-bindings/clock/qcom,rpmcc.h>
      #include <dt-bindings/clock/qcom,gcc-msm8953.h>

      bimc: interconnect@400000 {
          compatible = "qcom,msm8953-bimc";
          reg = <0x400000 0x5a000>;

          clock-names = "bus", "bus_a";
          clocks = <&rpmcc RPM_SMD_BIMC_CLK>,
                   <&rpmcc RPM_SMD_BIMC_A_CLK>;

          #interconnect-cells = <1>;
      };

      pcnoc: interconnect@500000 {
          compatible = "qcom,msm8953-pcnoc";
          reg = <0x500000 0x12080>;

          clock-names = "bus", "bus_a", "pcnoc_usb3_axi";
          clocks = <&rpmcc RPM_SMD_PCNOC_CLK>,
                   <&rpmcc RPM_SMD_PCNOC_A_CLK>,
                   <&gcc GCC_PCNOC_USB3_AXI_CLK>;

          #interconnect-cells = <1>;
      };

      snoc: interconnect@580000 {
          compatible = "qcom,msm8953-snoc";
          reg = <0x580000 0x16080>;

          clock-names = "bus", "bus_a";
          clocks = <&rpmcc RPM_SMD_SNOC_CLK>,
                   <&rpmcc RPM_SMD_SNOC_A_CLK>;

          #interconnect-cells = <1>;

          snoc_mm: interconnect {
              compatible = "qcom,msm8953-snoc-mm";

              clock-names = "bus", "bus_a";
              clocks = <&rpmcc RPM_SMD_SYSMMNOC_CLK>,
                       <&rpmcc RPM_SMD_SYSMMNOC_A_CLK>;

              #interconnect-cells = <1>;
          };
      };
```

## Documentation/devicetree/bindings/mfd/88pm88x.txt
```
Marvell 88pm88x combo PMIC chip

This series of chip integrates regulator, rtc, onkey, switch charger,
fuelgauge, gpadc and a range of I/O pins.

88pm886 and 88pm880 are two very similar chips, most of the registers mapping
and functions are the same, the main difference is the latter has a separate
i2c slave address to cover BUCK related setting

Required properties:
- compatible: one of the strings for a specific chip:
  "marvell,88pm886"
  "marvell,88pm880"
- reg: the i2c address
- interrupt-controller: it works as an interrupt controller managing its irqs
- interrupt-cells: this value is 1

Optional properties:
- marvell,88pm88x-irq-write-clear: the interrupt ack method


Example:

	pmic: 88pm886@30 {
		compatible = "marvell,88pm886";
		reg = <0x30>;
		interrupts = <0 4 IRQ_TYPE_LEVEL_HIGH>;
		interrupt-parent = <&gic>;
		interrupt-controller;
		#interrupt-cells = <1>;

		marvell,88pm88x-irq-write-clear;
	};
```

## Documentation/devicetree/bindings/mfd/twl6030-power.txt
```
Texas Instruments TWL family (twl6030) reset and power management module

For now, the binding only supports the complete shutdown of the system after
poweroff.

Required properties:
- compatible : must be
	"ti,twl6030-power"

Optional properties:

- ti,system-power-controller: This indicates that TWL6030 is the
  power supply master of the system. With this flag, the chip will
  initiate an ACTIVE-to-OFF or SLEEP-to-OFF transition when the
  system poweroffs.

Example:
&i2c1 {
	clock-frequency = <2600000>;

	twl: twl@48 {
		reg = <0x48>;
		interrupts = <7>; /* SYS_NIRQ cascaded to intc */
		interrupt-parent = <&intc>;

		twl_power: power {
			compatible = "ti,twl6030-power";
			ti,system-power-controller;
		};
	};
};
```

## Documentation/devicetree/bindings/power/supply/qcom,smbcharger.yaml
```yaml
# SPDX-License-Identifier: (GPL-2.0-only or BSD-2-Clause)
%YAML 1.2
---
$id: http://devicetree.org/schemas/power/supply/qcom,smbcharger.yaml#
$schema: http://devicetree.org/meta-schemas/core.yaml#

title: Qualcomm PMIC Switch-Mode Battery Charger

maintainers:
  - Yassine Oudjana <y.oudjana@protonmail.com>

properties:
  compatible:
    enum:
      - qcom,pmi8950-smbcharger
      - qcom,pmi8994-smbcharger
      - qcom,pmi8996-smbcharger

  reg:
    maxItems: 1

  monitored-battery:
    description: |
      phandle of battery characteristics node.
      The charger uses the following properties:
      - charge-term-current-microamp
      - voltage-max-design-microvolt
      The voltage-max-design-microvolt property must be set.
      See Documentation/devicetree/bindings/power/supply/battery.yaml

  # TODO: Improve interrupt descriptions
  interrupts:
    items:
      - description: Charger error
      - description: Charger inhibit
      - description: Charger soft precharge
      - description: Charger complete soft charge
      - description: Charger precharging to fast charging switch threshold
      - description: Charger recharge threshold
      - description: Charger taper threshold
      - description: Charger charge termination threshold
      - description: Battery hot
      - description: Battery warm
      - description: Battery cold
      - description: Battery cool
      - description: Battery overvoltage
      - description: Battery low
      - description: Battery missing
      # TODO: Figure out what this means
      - description: Battery terminal/terminate(?) missing
      - description: USB input undervolt
      - description: USB input overvolt
      - description: USB input source detected
      - description: OTG regulator failed
      - description: OTG regulator overcurrent
      - description: Automatic input current limiting done
      - description: USB ID pin changed
      - description: DC input undervolt
      - description: DC input overvolt
      - description: Power OK
      - description: Temperature shutdown
      - description: Watchdog timeout
      - description: Flash failed
      # TODO: Figure out what these mean
      - description: OTST2 (?)
      - description: OTST3 (?)

  interrupt-names:
    items:
      - const: chg-error
      - const: chg-inhibit
      - const: chg-prechg-sft
      - const: chg-complete-chg-sft
      - const: chg-p2f-thr
      - const: chg-rechg-thr
      - const: chg-taper-thr
      - const: chg-tcc-thr
      - const: batt-hot
      - const: batt-warm
      - const: batt-cold
      - const: batt-cool
      - const: batt-ov
      - const: batt-low
      - const: batt-missing
      - const: batt-term-missing
      - const: usbin-uv
      - const: usbin-ov
      - const: usbin-src-det
      - const: otg-fail
      - const: otg-oc
      - const: aicl-done
      - const: usbid-change
      - const: dcin-uv
      - const: dcin-ov
      - const: power-ok
      - const: temp-shutdown
      - const: wdog-timeout
      - const: flash-fail
      - const: otst2
      - const: otst3

  otg-vbus:
    type: object

    description: |
      OTG regulator subnode.

required:
  - compatible
  - reg
  - monitored-battery
  - interrupts
  - interrupt-names
  - otg-vbus

additionalProperties: false

examples:
  - |
    #include <dt-bindings/interrupt-controller/irq.h>

    battery: battery {
        compatible = "simple-battery";

        charge-full-design-microamp-hours = <4070000>;
        charge-term-current-microamp = <100000>;
        voltage-min-design-microvolt = <3400000>;
        voltage-max-design-microvolt = <4400000>;
    };

    pmic {
        #address-cells = <1>;
        #size-cells = <0>;

        charger@1000 {
            compatible = "qcom,pmi8996-smbcharger";
            reg = <0x1000>;

            interrupts = <0x2 0x10 0x0 IRQ_TYPE_EDGE_BOTH>,
                         <0x2 0x10 0x1 IRQ_TYPE_EDGE_BOTH>,
                         <0x2 0x10 0x2 IRQ_TYPE_EDGE_BOTH>,
                         <0x2 0x10 0x3 IRQ_TYPE_EDGE_BOTH>,
                         <0x2 0x10 0x4 IRQ_TYPE_EDGE_BOTH>,
                         <0x2 0x10 0x5 IRQ_TYPE_EDGE_BOTH>,
                         <0x2 0x10 0x6 IRQ_TYPE_EDGE_RISING>,
                         <0x2 0x10 0x7 IRQ_TYPE_EDGE_RISING>,
                         <0x2 0x12 0x0 IRQ_TYPE_EDGE_BOTH>,
                         <0x2 0x12 0x1 IRQ_TYPE_EDGE_BOTH>,
                         <0x2 0x12 0x2 IRQ_TYPE_EDGE_BOTH>,
                         <0x2 0x12 0x3 IRQ_TYPE_EDGE_BOTH>,
                         <0x2 0x12 0x4 IRQ_TYPE_EDGE_BOTH>,
                         <0x2 0x12 0x5 IRQ_TYPE_EDGE_BOTH>,
                         <0x2 0x12 0x6 IRQ_TYPE_EDGE_BOTH>,
                         <0x2 0x12 0x7 IRQ_TYPE_EDGE_BOTH>,
                         <0x2 0x13 0x0 IRQ_TYPE_EDGE_BOTH>,
                         <0x2 0x13 0x1 IRQ_TYPE_EDGE_BOTH>,
                         <0x2 0x13 0x2 IRQ_TYPE_EDGE_BOTH>,
                         <0x2 0x13 0x3 IRQ_TYPE_EDGE_BOTH>,
                         <0x2 0x13 0x4 IRQ_TYPE_EDGE_RISING>,
                         <0x2 0x13 0x5 IRQ_TYPE_EDGE_RISING>,
                         <0x2 0x13 0x6 IRQ_TYPE_EDGE_FALLING>,
                         <0x2 0x14 0x0 IRQ_TYPE_EDGE_BOTH>,
                         <0x2 0x14 0x1 IRQ_TYPE_EDGE_BOTH>,
                         <0x2 0x16 0x0 IRQ_TYPE_EDGE_BOTH>,
                         <0x2 0x16 0x1 IRQ_TYPE_EDGE_BOTH>,
                         <0x2 0x16 0x2 IRQ_TYPE_EDGE_BOTH>,
                         <0x2 0x16 0x3 IRQ_TYPE_EDGE_BOTH>,
                         <0x2 0x16 0x4 IRQ_TYPE_EDGE_BOTH>,
                         <0x2 0x16 0x5 IRQ_TYPE_EDGE_BOTH>;
            interrupt-names = "chg-error",
                              "chg-inhibit",
                              "chg-prechg-sft",
                              "chg-complete-chg-sft",
                              "chg-p2f-thr",
                              "chg-rechg-thr",
                              "chg-taper-thr",
                              "chg-tcc-thr",
                              "batt-hot",
                              "batt-warm",
                              "batt-cold",
                              "batt-cool",
                              "batt-ov",
                              "batt-low",
                              "batt-missing",
                              "batt-term-missing",
                              "usbin-uv",
                              "usbin-ov",
                              "usbin-src-det",
                              "otg-fail",
                              "otg-oc",
                              "aicl-done",
                              "usbid-change",
                              "dcin-uv",
                              "dcin-ov",
                              "power-ok",
                              "temp-shutdown",
                              "wdog-timeout",
                              "flash-fail",
                              "otst2",
                              "otst3";

            monitored-battery = <&battery>;

            otg-vbus { };
        };
    };
```

## drivers/input/touchscreen/goodix_gt738x/Kconfig
```kconfig
#
# Goodix touchscreen driver configuration
#
menuconfig TOUCHSCREEN_GOODIX_GT738X
	bool "Goodix GT738x touchscreen"
	depends on I2C
	default y
	help
	  Say Y here if you have a Goodix GT738x touch controller
	  to your system.

	  If unsure, say N.

if TOUCHSCREEN_GOODIX_GT738X

config TOUCHSCREEN_GOODIX_GT738X_UPDATE
	tristate "Goodix GT738x firmware update module"
	default y
	help
	  Say Y here to enable support for doing firmware update.

	  If unsure, say N.

	  To compile this driver as a module, choose M here.

config TOUCHSCREEN_GOODIX_GT738X_GESTURE
	tristate "Goodix GT738x gesture wakeup feature"
	default n
	help
	  Say Y here to enable support for gesture wakeup feature..

	  If unsure, say N.

	  To compile this driver as a module, choose M here.

config TOUCHSCREEN_GOODIX_GT738X_TOOLS
	tristate "Goodix touch tools support"
	default n
	help
	  Say Y here to enable debug tools.

	  If unsure, say N.

	  To compile this driver as a module, choose M here.

endif
```
